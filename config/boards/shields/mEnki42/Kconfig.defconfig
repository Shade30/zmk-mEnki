## config/boards/shields/mEnki42/Kconfig.defconfig
```kconfig
# Copyright (c) 2020 The ZMK Contributors
# SPDX-License-Identifier: MIT

if SHIELD_MENKI42

config ZMK_KEYBOARD_NAME
	default "mEnki42"
	
endif



config ZMK_SPLIT
	default n
```

## config/west.yml
```yaml
manifest:
  remotes:
    - name: zmkfirmware
      url-base: https://github.com/zmkfirmware
    - name: sqdbruh
      url-base: https://github.com/sqdbruh
  projects:
    - name: zmk
      remote: sqdbruh
      revision: main
      import: app/west.yml
  self:
    path: config
```
